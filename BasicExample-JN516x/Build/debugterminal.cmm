; Demo script to start an JN156x type CPU. It's assumed that the 
; input files are generated by NXP's cygwin based build environment.
;
; Prerequisite:
;  * Initial Flash image with DEBUG ENABLE is loaded
;

; Constants
LOCAL &BootstrapBp
&BootstrapBp=0x32A

; Configure Debugger
SYStem.CPU JN5168
SYStem.Option.LittleEnd OFF
SYStem.Option.TURBO OFF

; Delete existing terminal window and
; enable the polling mode for DBG_vPrintf() output
term.reset
SYStem.Option LPMDebug ON



IF RUN()
	GOSUB TryBreak

FLASH.RESet
MAP.RESet
; Configure Flash, Ram, .. region
; Define ROM/Flash region -> use OnChip Breakpoints
MAP.BOnchip 0x00000--0x01FFF ; Boot Code Flash
MAP.BOnchip 0x80000--0xBFFFF ; Application Flash

; Define unpopulated RAM regions
MAP.DenyAccess 0x00002000--0x0007FFFF
MAP.DenyAccess 0x000C0000--0x01FFFFFF
MAP.DenyAccess 0x02008000--0x03FFFFFF
MAP.DenyAccess 0x04008000--0xEFFFFFFF
MAP.DenyAccess 0xF0020000--0xFFFFFFFF

; Connect to the Device
SYStem.Up

; Program Flash
LOCAL &filename &bin_file &elf_file

&filename="AN1193_Terminal_JN5168_hwdbg.bin"
&elf_file=STRing.Replace("&filename",OS.FILE.EXTENSION("&filename"),".elf",-1)
&bin_file=STRing.Replace("&filename",OS.FILE.EXTENSION("&filename"),".bin",-1)

IF !OS.FILE("&elf_file")
(
  PRINT %ERROR "ELF-File not found: &elf_file"
  ENDDO
)

GOSUB FlashReProgram &elf_file &bin_file

; Load Symbols
Data.LOAD.Elf &elf_file /NoCODE /CYGDRIVE

GOSUB Bootstrap

; Switch to Hll Mode
Mode.Hll

; Enable the terminal for DBG_vPrintf() output

; second 0x0 is buffer from terminal to target (e.g. if using getch) 
TERM.METHOD BQUICK ADDRESS.OFFSET(sYmbol.BEGIN(DBG_vLbSpot.1449)) ADDRESS.OFFSET(Var.ADDRESS(DBG_au8LbPutBuffer)) ADDRESS.OFFSET(Var.ADDRESS(DBG_au8LbGetBuffer))

TERM.Scroll On
term.size 50 3000
WinPOS ,,,,,,myterm
TERM


;Go AppColdStart
Register.Set R9 0x0
Data.List

ENDDO

;==============================================================================
; SUBROUTINES
;==============================================================================

; ReProgram Flash of the JN516x device. Before the Flash content is modified
; the new Flash content will be checked for the Debug Enable Bit.
FlashReProgram: ;(elf_file, bin_file)
  LOCAL &elf_file &bin_file
  ENTRY &elf_file &bin_file
  
  DO ~~/demo/beyond/flash/jn516x PREPAREONLY
  
  TrOnchip.Set DPFE ON ; Workaround for Watchdog & Stack Overflow
  
  FLASH.ReProgram ALL
  IF OS.FILE("&bin_file")
  (
    Data.LOAD.Binary &bin_file FLASH.UNIT.BEGIN(1.)--FLASH.UNIT.END(1.) /SKIP 4.
  )
  ELSE
  (
    Data.LOAD.Elf &elf_file FLASH.UNIT.BEGIN(1.)--FLASH.UNIT.END(1.) /NosYmbol
  )
  
  ; JN516x Bootloader specific
  ; Check if the flash image ENABLES JTAG or NOT
  LOCAL &jtag_enabled
  GOSUB CheckFlashImage
  ENTRY &jtag_enabled

  IF !&jtag_enabled
  (
    DIALOG.YESNO "The selected Flash Image does not enable JTAG! Do you want to proceed and reprogram flash?"
    LOCAL &proceed
    ENTRY &proceed
    IF !(&proceed)
    (
      FLASH.ReProgram ALL
      FLASH.ReProgram OFF
      TrOnchip.Set DPFE OFF ; Workaround for Watchdog & Stack Overflow
      ENDDO
    )
  )
  ; ReProgram Flash
  FLASH.ReProgram OFF
  
  TrOnchip.Set DPFE OFF ; Workaround for Watchdog & Stack Overflow
  RETURN
  
;========================================================================
; Check for the JN516x specific flash header.
; This allows an check for the JTAG Enable bit.
CheckFlashImage:
  LOCAL &jtag_enabled
  
  ; Check for the JN516x flash header
  ; header valid -> check the jtag_enable bit
  &flash_header=(Data.Long(A:FLASH.UNIT.BEGIN(1.)+0x0)==0x12345678)&&(Data.Long(A:FLASH.UNIT.BEGIN(1.)+0x4)==0x11223344)
  &jtag_enabled=(Data.Byte(A:FLASH.UNIT.BEGIN(1.)+0x1F)&0x1)==0x1
  
  &jtag_enabled=((&jtag_enabled)&&(&flash_header))
  RETURN &jtag_enabled

Bootstrap:
  ; First check whether JTAG is enabled for the Bootloader
  LOCAL &jtag_enabled
  GOSUB CheckFlashImage
  ENTRY &jtag_enabled
  
  if !(&jtag_enabled)
  (
    LOCAL &yes
    DIALOG.YESNO "The programmed Flash Image does not activate JTAG! Do you really want to proceed?"
    ENTRY &yes

    if !&yes
    (
      print %ERROR "Boot process aborted! Attention: JTAG may be disabled with next RESET!"
      ENDDO
    )
  )
  ; Reset the Device, let Bootloader execute, jump to function entry point

  SYStem.Up
  print ""
  GO &BootstrapBp
  WAIT !run(),1.s
  IF RUN()
  (
    PRINT %ERROR "Bootloader did not stop as expected. Abort boot process!"
    ENDDO
  )
  Register.Set PC AppColdStart
  

  RETURN
  
TryBreak:
  ; Try to BREAK the CPU. Due to the sleep modes this is not always possible.
  ; In a such situation use an CPU reset.
  ON ERROR GOTO TryBreakTimeout
  BREAK
  RETURN
TryBreakTimeout:
  ON ERROR NOTHING
  DIALOG.YESNO "Attention, CPU did not stop on Break command. Do you want to RESET the CPU? Press YES for RESET and NO to abort."
  LOCAL &reset
  ENTRY &reset
  IF &reset
  (
    SYStem.Up
  )
  ELSE
  (
    ENDDO
  )
  RETURN
